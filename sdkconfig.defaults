## sdkconfig.defaults
```kconfig
# Enable custom partition table for OTA support
CONFIG_PARTITION_TABLE_CUSTOM=y
CONFIG_PARTITION_TABLE_CUSTOM_FILENAME="partitions.csv"

# Enable OTA support
CONFIG_BOOTLOADER_APP_ROLLBACK_ENABLE=y

# Flash size - ESP32-WROOM-32UE comes in 4MB, 8MB, or 16MB variants
# Partition table uses ~3.1MB, so minimum is 4MB
CONFIG_ESPTOOLPY_FLASHSIZE_4MB=y
CONFIG_ESPTOOLPY_FLASHSIZE="4MB"

# PSRAM (board has 32MB PSRAM - HEX mode, 200MHz)
# Based on Waveshare ESP32-P4-WIFI6-POE-ETH board example configs
CONFIG_SPIRAM=y
CONFIG_SPIRAM_MODE_HEX=y
CONFIG_SPIRAM_SPEED_200M=y
CONFIG_SPIRAM_BOOT_INIT=y
CONFIG_SPIRAM_USE_MALLOC=y
CONFIG_SPIRAM_MEMTEST=y
CONFIG_SPIRAM_MALLOC_ALWAYSINTERNAL=16384
CONFIG_SPIRAM_MALLOC_RESERVE_INTERNAL=32768
```
